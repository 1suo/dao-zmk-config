## config/boards/arm/dao/Kconfig
```kconfig
# Copyright (c) 2021 Rafael Yumagulov
# SPDX-License-Identifier: MIT

config BOARD_ENABLE_DCDC
	bool "Enable DCDC mode"
	select SOC_DCDC_NRF52X
	default y
	depends on (BOARD_Dao_LEFT || BOARD_Dao_RIGHT)
```

## config/boards/arm/dao/Kconfig.board
```kconfig
# Dao board configuration

# Copyright (c) 2021 Rafael Yumagulov
# SPDX-License-Identifier: MIT

config BOARD_Dao_LEFT
	bool "Dao_left"
	depends on SOC_NRF52840_QIAA

config BOARD_DAO_RIGHT
	bool "Dao_right"
	depends on SOC_NRF52840_QIAA
```
