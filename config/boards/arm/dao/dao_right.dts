/*
 * Copyright (c) 2021 Rafael Yumagulov
 *
 * SPDX-License-Identifier: MIT
 */

#include "dao.dtsi"

&default_transform {
	col-offset = <6>;
};

&extra_keys_transform {
	col-offset = <6>;
};

&kscan0 {
	col-gpios
		= <&gpio0 12 GPIO_ACTIVE_HIGH>
		, <&gpio1  11 GPIO_ACTIVE_HIGH>
		, <&gpio0  10 GPIO_ACTIVE_HIGH>
		, <&gpio0 18 GPIO_ACTIVE_HIGH>
		, <&gpio0 19 GPIO_ACTIVE_HIGH>
		, <&gpio0 21 GPIO_ACTIVE_HIGH>
		;
};
